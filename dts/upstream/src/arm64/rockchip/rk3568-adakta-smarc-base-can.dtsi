// SPDX-License-Identifier: (GPL-2.0+ OR MIT)
/*
 * Copyright (c) 2024 Adakta, Ltd.
 *
 */

/ {
	/* TODO: WIP no upstream patches */
	can0: can@fe570000 {
		compatible = "rockchip,rk3568v2-canfd";
		reg = <0x0 0xfe570000 0x0 0x1000>;
		interrupts = <GIC_SPI 1 IRQ_TYPE_LEVEL_HIGH>;
		clocks = <&cru CLK_CAN0>, <&cru PCLK_CAN0>;
		clock-names = "baud", "pclk";
		resets = <&cru SRST_CAN0>, <&cru SRST_P_CAN0>;
		reset-names = "core", "apb";
		pinctrl-names = "default";
		pinctrl-0 = <&can0m0_pins>;
		status = "disabled";
	};

	/* TODO: WIP no upstream patches */
	can1: can@fe580000 {
		compatible = "rockchip,rk3568v2-canfd";
		reg = <0x0 0xfe580000 0x0 0x1000>;
		interrupts = <GIC_SPI 2 IRQ_TYPE_LEVEL_HIGH>;
		clocks = <&cru CLK_CAN1>, <&cru PCLK_CAN1>;
		clock-names = "baud", "pclk";
		resets = <&cru SRST_CAN1>, <&cru SRST_P_CAN1>;
		reset-names = "core", "apb";
		pinctrl-names = "default";
		pinctrl-0 = <&can1m0_pins>;
		status = "disabled";
	};

	/* TODO: WIP no upstream patches */
	can2: can@fe590000 {
		compatible = "rockchip,rk3568v2-canfd";
		reg = <0x0 0xfe590000 0x0 0x1000>;
		interrupts = <GIC_SPI 3 IRQ_TYPE_LEVEL_HIGH>;
		clocks = <&cru CLK_CAN2>, <&cru PCLK_CAN2>;
		clock-names = "baud", "pclk";
		resets = <&cru SRST_CAN2>, <&cru SRST_P_CAN2>;
		reset-names = "core", "apb";
		pinctrl-names = "default";
		pinctrl-0 = <&can2m0_pins>;
		status = "disabled";
	};
};

&can0 {
	compatible = "rockchip,rk3568v3-canfd", "rockchip,rk3568v2-canfd";
	pinctrl-names = "default";
	pinctrl-0 = <&can0m0_pins>;
	status = "okay";
};

&can1 {
	compatible = "rockchip,rk3568v3-canfd", "rockchip,rk3568v2-canfd";
	pinctrl-names = "default";
	pinctrl-0 = <&can1m1_pins>;
	status = "okay";
};

&can2 {
	compatible = "rockchip,rk3568v3-canfd", "rockchip,rk3568v2-canfd";
	pinctrl-names = "default";
	pinctrl-0 = <&can2m0_pins>;
	status = "okay";
};
