## board/adakta/adakta-ad-rk3588/Kconfig
```kconfig
if TARGET_ADAKTA_AD_RK3588

config SYS_BOARD
	default "adakta-ad-rk3588"

config SYS_VENDOR
	default "adakta"

config SYS_CONFIG_NAME
	default "adakta-ad-rk3588"

endif
```

## board/adakta/adakta-mod-rk3588/Kconfig
```kconfig
if TARGET_ADAKTA_MOD_RK3588

config SYS_BOARD
	default "adakta-mod-rk3588"

config SYS_VENDOR
	default "adakta"

config SYS_CONFIG_NAME
	default "adakta-mod-rk3588"

endif
```

## board/adakta/adakta-smarc-rk3568/Kconfig
```kconfig
if TARGET_ADAKTA_SMARC_RK3568

config SYS_BOARD
	default "adakta-smarc-rk3568"

config SYS_VENDOR
	default "adakta"

config SYS_CONFIG_NAME
	default "adakta-smarc-rk3568"

endif
```
